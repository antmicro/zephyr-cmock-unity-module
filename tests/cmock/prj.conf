## CMakeLists.txt
```
# Copyright (c) 2023 Antmicro <www.antmicro.com>
# SPDX-License-Identifier: Apache-2.0

cmake_minimum_required(VERSION 3.20.0)
find_package(Zephyr REQUIRED HINTS $ENV{ZEPHYR_BASE})
project(hello_world)

test_runner_generate(src/main.c)
cmock_handle(${ZEPHYR_BASE}/include/zephyr/drivers/gpio.h drivers)

target_sources(app PRIVATE src/main.c)
```

## prj.conf
```kconfig
CONFIG_UNITY=y
CONFIG_CMOCK=y
```

## src/main.c
```c
#include "drivers/mock_gpio.h"

void test_cmock(void)
{
	const struct device *gpio_dev = device_get_binding("gpio0");

	/* Expect pin 0 to be high */
	gpio_pin_get_raw_ExpectAndReturn(gpio_dev, 0, 1);

	/* Expect pin 1 to be low */
	gpio_pin_get_raw_ExpectAndReturn(gpio_dev, 1, 0);

	/* Test if pin 0 is high */
	TEST_ASSERT_TRUE(gpio_pin_get_raw(gpio_dev, 0));

	/* Test if pin 1 is low */
	TEST_ASSERT_FALSE(gpio_pin_get_raw(gpio_dev, 1));
}

void main(void)
{
	(void)unity_main();
}
```
