## Kconfig
```kconfig
menu "Unity/CMock"

config UNITY
	bool "Use Unity Test framework"
	select REQUIRES_FULL_LIBC
	help
	  Select this option to enable the Unity Test framework.

config CMOCK
	bool "Use the CMock mock/stub generator"
	depends on UNITY
	help
	  Select this option to enable the CMock mock/stub generator.

endmenu
```

## tests/cmock/testcase.yaml
```yaml
# Copyright (c) 2023 Antmicro <www.antmicro.com>
# SPDX-License-Identifier: Apache-2.0

tests:
  testing.cmock:
    tags: testing cmock
    platform_exclude: qemu_xtensa
```

## tests/unity/testcase.yaml
```yaml
# Copyright (c) 2023 Antmicro <www.antmicro.com>
# SPDX-License-Identifier: Apache-2.0

tests:
  testing.unity:
    tags: testing unity
    platform_exclude: qemu_xtensa
```

## west.yml
```yaml
manifest:
  self:
    path: zephyr-cmock-unity-module

  remotes:
    - name: throwtheswitch
      url-base: https://github.com/ThrowTheSwitch

  projects:
    - name: cmock
      path: test/cmock
      remote: throwtheswitch
      revision: v2.5.3
    - name: unity
      path: test/cmock/vendor/unity
      remote: throwtheswitch
      revision: v2.5.2
```
